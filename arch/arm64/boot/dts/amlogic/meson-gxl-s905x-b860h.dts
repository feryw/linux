// SPDX-License-Identifier: (GPL-2.0+ OR MIT)
/*
 * sibondt
 */

/dts-v1/;

#include "meson-gxl-s905x-p212.dts"

/ {
	compatible = "zte,b860h", "amlogic,p212";
	model = "ZTE B860H V1/2";

};

&sdio_pwrseq {
	reset-gpios = <&gpio GPIODV_27 GPIO_ACTIVE_LOW>;
};
